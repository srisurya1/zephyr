## boards/ti/tm4c123gxl/Kconfig.tm4c123gxl
```kconfig
# Copyright (c) 2024, Your Name
# SPDX-License-Identifier: Apache-2.0

config BOARD_TM4C123GXL
	select SOC_TI_TM4C123GH6PM
```

## boards/ti/tm4c123gxl/tm4c123gxl_defconfig
```kconfig
# SPDX-License-Identifier: Apache-2.0
#
# Copyright (c) 2026 Linumiz
# Author: Sri Surya <srisurya@linumiz.com>

# Default configuration for TI TM4C123GXL LaunchPad


# Enable ARM Cortex-M4F features
#CONFIG_FPU=y
#CONFIG_BUILD_OUTPUT_HEX=y


# Console / UART
CONFIG_SERIAL=y
CONFIG_CONSOLE=y
CONFIG_UART_CONSOLE=y

#CONFIG_UART_STELLARIS=y
#CONFIG_UART_STELLARIS_PORT_0=y
#CONFIG_UART_STELLARIS_PORT_1=y
# GPIO
#CONFIG_GPIO=y

# Pin control
#CONFIG_PINCTRL=y

# TivaWare HAL
#CONFIG_TIVA_HAL=y
#CONFIG_TIVA_HAL_USE_UART=y
#CONFIG_TIVA_HAL_USE_SYSCTL=y
#CONFIG_TIVA_HAL_USE_GPIO=y
```

## dts/bindings/pinctrl/ti,tiva-c-pinctrl.yaml
```yaml
# Copyright (c) 2024, Your Name
# SPDX-License-Identifier: Apache-2.0

description: |
  TI Tiva C Series pin controller.

  Device pin configuration should be placed in child nodes of this node.
  Each child node specifies a TivaWare pin-mux value and the peripheral
  type for the pin.

  The pinmux value encodes the port and pin information (same encoding
  used by TivaWare GPIOPinConfigure()), so no separate port/pin
  properties are needed:
    - Port index: (pinmux >> 16) & 0xFF  (0=A, 1=B, ... 5=F)
    - Pin number: ((pinmux >> 8) & 0xFF) / 4

  Example for UART0 on PA0/PA1:

    &pinctrl {
      uart0_rx_pa0: uart0_rx_pa0 {
        pinmux = <0x00000001>;   /* GPIO_PA0_U0RX */
        ti,pin-type = <1>;       /* UART */
      };
      uart0_tx_pa1: uart0_tx_pa1 {
        pinmux = <0x00000401>;   /* GPIO_PA1_U0TX */
        ti,pin-type = <1>;       /* UART */
      };
    };

compatible: "ti,tiva-c-pinctrl"

include: base.yaml

properties:
  reg:
    required: true

child-binding:
  description: TI Tiva C pin configuration node.

  include:
    - name: pincfg-node.yaml
      property-allowlist:
        - bias-disable
        - bias-pull-up
        - bias-pull-down
        - drive-open-drain

  properties:
    pinmux:
      required: true
      type: int
      description: |
        TivaWare GPIO_Pxy_FUNC value from pin_map.h.
        For example GPIO_PA0_U0RX = 0x00000001.
        Encodes port, pin, and mux function.

    ti,pin-type:
      type: int
      default: 0
      enum: [0, 1, 2, 3, 4, 5, 6]
      description: |
        Peripheral type for pin function setup:
          0 = GPIO (default)
          1 = UART
          2 = I2C
          3 = I2C SCL
          4 = SSI/SPI
          5 = CAN
          6 = PWM
```

## dts/bindings/serial/ti,tiva-c-uart.yaml
```yaml
description: TI Tiva C Series UART

compatible: "ti,tiva-c-uart"

include: [uart-controller.yaml, pinctrl-device.yaml]

properties:
  reg:
    required: true

  interrupts:
    required: true

  clocks:
    required: true
    description: |
      Phandle to the system clock providing the UART baud-rate reference.

  peripheral-id:
    type: int
    required: true
    description: |
      UART peripheral index (0-7). Used to enable the clock via
      SysCtlPeripheralEnable(SYSCTL_PERIPH_UARTn).

  pinctrl-0:
    required: true

  pinctrl-names:
    required: true
```

## soc/ti/tiva_c/Kconfig
```kconfig
# Copyright (c) 2024
# SPDX-License-Identifier: Apache-2.0


if SOC_FAMILY_TI_TIVA_C

rsource "*/Kconfig"

endif # SOC_FAMILY_TI_TIVA_C
```

## soc/ti/tiva_c/Kconfig.defconfig
```kconfig
# TI Tiva C Series platform configuration defaults

# Copyright (c) 2024
# SPDX-License-Identifier: Apache-2.0

if SOC_FAMILY_TI_TIVA_C

rsource "*/Kconfig.defconfig"

endif # SOC_FAMILY_TI_TIVA_C
```

## soc/ti/tiva_c/Kconfig.soc
```kconfig
# Copyright (c) 2024
# SPDX-License-Identifier: Apache-2.0

config SOC_FAMILY_TI_TIVA_C
	bool

config SOC_FAMILY
	default "ti_tiva_c" if SOC_FAMILY_TI_TIVA_C

rsource "*/Kconfig.soc"
```

## soc/ti/tiva_c/tm4c123x/Kconfig
```kconfig
# TI Tiva C TM4C123x Series

# Copyright (c) 2024
# SPDX-License-Identifier: Apache-2.0

config SOC_SERIES_TM4C123X
	select ARM
	select CPU_CORTEX_M4
	select CPU_CORTEX_M_HAS_DWT
	select CPU_HAS_ARM_MPU
	select CPU_HAS_FPU
	select PINCTRL
	select HAS_TIVAWARE
	select BUILD_OUTPUT_HEX
	select SOC_EARLY_INIT_HOOK
```
